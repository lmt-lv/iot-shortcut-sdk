## CMakeLists.txt
```
cmake_minimum_required(VERSION 3.20.0)

find_package(Zephyr REQUIRED HINTS $ENV{ZEPHYR_BASE})
project(libbuilder)


message(STATUS "Building lmtSDK from source.")
zephyr_library_named(lmtSDK)

list(APPEND CMAKE_MODULE_PATH ${ZEPHYR_BASE}/modules/nanopb)
include(nanopb)

# Define the library sources. Need to include littleFS otherwise it will not compile
zephyr_include_directories(
	${CMAKE_CURRENT_LIST_DIR}/../../inc
	${ZEPHYR_BASE}/../modules/fs/littlefs
)

# Define the library sources
FILE(GLOB LMTSDK_SOURCES ${CMAKE_CURRENT_LIST_DIR}/../../src/*.c)
zephyr_library_sources(${LMTSDK_SOURCES})

if (CONFIG_THREAD_ANALYZER)
	if (CONFIG_FP_HARDABI)
		if (CONFIG_CPU_CORTEX_M33)
			#fpv5-sp-d16-hard
			set_target_properties(lmtSDK PROPERTIES ARCHIVE_OUTPUT_DIRECTORY ${CMAKE_CURRENT_SOURCE_DIR}/../../lib/debug/${GCC_M_CPU})
		elseif(CONFIG_CPU_CORTEX_M4)
			#fpv4-sp-d16-hard
			set_target_properties(lmtSDK PROPERTIES ARCHIVE_OUTPUT_DIRECTORY ${CMAKE_CURRENT_SOURCE_DIR}/../../lib/debug/${GCC_M_CPU})
		else()
			assert(0 "Unsupported configuration.")
		endif()
	else()
		#zephyr_library_compile_definitions(BME68X_DO_NOT_USE_FPU)
		if (CONFIG_CPU_CORTEX_M33 OR CONFIG_CPU_CORTEX_M4)
			set_target_properties(lmtSDK PROPERTIES ARCHIVE_OUTPUT_DIRECTORY ${CMAKE_CURRENT_SOURCE_DIR}/../../lib/debug/)
		else()
			assert(0 "Unsupported configuration.")
		endif()
	endif()
else()
	if (CONFIG_FP_HARDABI)
		if (CONFIG_CPU_CORTEX_M33)
			#fpv5-sp-d16-hard
			set_target_properties(lmtSDK PROPERTIES ARCHIVE_OUTPUT_DIRECTORY ${CMAKE_CURRENT_SOURCE_DIR}/../../lib/${GCC_M_CPU})
		elseif(CONFIG_CPU_CORTEX_M4)
			#fpv4-sp-d16-hard
			set_target_properties(lmtSDK PROPERTIES ARCHIVE_OUTPUT_DIRECTORY ${CMAKE_CURRENT_SOURCE_DIR}/../../lib/${GCC_M_CPU})
		else()
			assert(0 "Unsupported configuration.")
		endif()
	else()
		#zephyr_library_compile_definitions(BME68X_DO_NOT_USE_FPU)
		if (CONFIG_CPU_CORTEX_M33 OR CONFIG_CPU_CORTEX_M4)
			set_target_properties(lmtSDK PROPERTIES ARCHIVE_OUTPUT_DIRECTORY ${CMAKE_CURRENT_SOURCE_DIR}/../../lib/)
		else()
			assert(0 "Unsupported configuration.")
		endif()
	endif()
endif()

# Check if running inside Docker via env variable
if(NOT "$ENV{ZEPHYR_IN_DOCKER}" STREQUAL "1")

	# Define the custom export target only if NOT in Docker
	add_custom_target(export_lmtSDK ALL
		${EXPORT_COMMANDS}
		COMMENT "Updating lmtSDK export"
		VERBATIM
	)

	# Add dependency only if target exists
	add_dependencies(export_lmtSDK lmtSDK)

else()
	message(STATUS "Skipping lmtSDK export in Docker")
endif()


#zephyr_nanopb_sources(app boards/arm/lmt_som_nrf9160/lib/extra/A2.proto)

message(STATUS "Called from parent CMakeLists.txt at: ${CMAKE_SOURCE_DIR}")

# Prepare for DDT FS
set(PM_CONFIG_H "${CMAKE_BINARY_DIR}/zephyr/include/generated/pm_config.h")

set(GEN_LMT_DDT_FS_START_PY "${CMAKE_CURRENT_SOURCE_DIR}/../../scripts/gen_lmt_ddt_fs_start.py")
set(GEN_LMT_DDT_FS_NVS_PY "${CMAKE_CURRENT_SOURCE_DIR}/../../scripts/gen_lmt_ddt_fs_nvs.py")
set(GEN_LMT_DDT_FS_LFS_PY "${CMAKE_CURRENT_SOURCE_DIR}/../../scripts/gen_lmt_ddt_fs_lfs.py")

set(LMT_GEN_C_DIR "${CMAKE_CURRENT_BINARY_DIR}/lmt_generated")
set(LMT_DDT_FS_C "${LMT_GEN_C_DIR}/lmt_ddt_fs.c")

file(MAKE_DIRECTORY "${LMT_GEN_C_DIR}")

# Generate the C file start
add_custom_command(
	OUTPUT ${CMAKE_CURRENT_BINARY_DIR}/lmt_ddt_fs.c.start.ok
	COMMAND ${PYTHON_EXECUTABLE} ${GEN_LMT_DDT_FS_START_PY}
			${LMT_GEN_C_DIR}
	COMMAND ${CMAKE_COMMAND} -E touch ${CMAKE_CURRENT_BINARY_DIR}/lmt_ddt_fs.c.start.ok
	DEPENDS ${PM_CONFIG_H} ${GEN_LMT_DDT_FS_START_PY}
	COMMENT "Generating start of lmt_ddt_fs.c"
	VERBATIM
)

add_custom_target(generate_lmt_ddt_fs_start DEPENDS ${CMAKE_CURRENT_BINARY_DIR}/lmt_ddt_fs.c.start.ok)

# Generate the NVS section
add_custom_command(
	OUTPUT ${CMAKE_CURRENT_BINARY_DIR}/lmt_ddt_fs.c.nvs.ok
	COMMAND ${PYTHON_EXECUTABLE} ${GEN_LMT_DDT_FS_NVS_PY}
			${LMT_GEN_C_DIR} ${PM_CONFIG_H} nvs_storage fs_nvs
	COMMAND ${CMAKE_COMMAND} -E touch ${CMAKE_CURRENT_BINARY_DIR}/lmt_ddt_fs.c.nvs.ok
	DEPENDS ${PM_CONFIG_H} ${GEN_LMT_DDT_FS_NVS_PY}
	COMMENT "Appending NVS section"
	VERBATIM
)

add_custom_target(generate_lmt_ddt_fs_nvs DEPENDS ${CMAKE_CURRENT_BINARY_DIR}/lmt_ddt_fs.c.nvs.ok)
add_dependencies(generate_lmt_ddt_fs_nvs generate_lmt_ddt_fs_start)

# Generate the LFS section
dt_node_exists(LFS1_PRESENT PATH /fstab/lfs1)
if(LFS1_PRESENT)

	add_custom_command(
		OUTPUT ${LMT_DDT_FS_C}
		COMMAND ${PYTHON_EXECUTABLE} ${GEN_LMT_DDT_FS_LFS_PY}
				${LMT_GEN_C_DIR} ${PM_CONFIG_H}
				littlefs_storage fs_lfs_config fs_lfs_mount /lfs
		DEPENDS ${PM_CONFIG_H} ${GEN_LMT_DDT_FS_LFS_PY}
		COMMENT "Appending LFS section"
	)

	add_custom_target(generate_lmt_ddt_fs_lfs DEPENDS ${LMT_DDT_FS_C})
	add_dependencies(generate_lmt_ddt_fs_lfs generate_lmt_ddt_fs_nvs)

	add_custom_target(generate_lmt_ddt_fs ALL DEPENDS generate_lmt_ddt_fs_lfs)

else()
	message(STATUS "Log filesystem in internal storage")
	#ToDo: more info needed
	# storage_partition
	add_custom_target(generate_lmt_ddt_fs ALL DEPENDS generate_lmt_ddt_fs_nvs)
endif()

# 1. Generate json.bin from /etc
set(ETC_FOLDER "${CMAKE_SOURCE_DIR}/etc")
set(GEN_JSON_SCRIPT "${CMAKE_CURRENT_SOURCE_DIR}/../../scripts/gen_json_bin.py")
set(JSON_BIN "${CMAKE_CURRENT_BINARY_DIR}/json.bin")

file(GLOB ETC_FILES "${ETC_FOLDER}/*.json")

add_custom_command(
	OUTPUT ${JSON_BIN}
	COMMAND ${PYTHON_EXECUTABLE} ${GEN_JSON_SCRIPT}
			--input-dir ${ETC_FOLDER}
			--output-file ${JSON_BIN}
			--max-size 8192
	DEPENDS ${GEN_JSON_SCRIPT} ${ETC_FILES}
	COMMENT "Generating JSON binary file (json.bin) from ${ETC_FOLDER}"
	VERBATIM
)

add_custom_target(generate_json_bin ALL DEPENDS ${JSON_BIN})
add_dependencies(generate_json_bin generate_lmt_ddt_fs)

# 2. Convert json.bin into a C source file containing uint8_t coap[] = { ... };
set(VAR_NAME coap_data)
set(BIN2C_SCRIPT "${CMAKE_CURRENT_SOURCE_DIR}/../../scripts/bin2c_array.py")
set(C_BIN_ARRAY_C "${LMT_GEN_C_DIR}/${VAR_NAME}_array.c")
set(C_BIN_ARRAY_H "${LMT_GEN_C_DIR}/${VAR_NAME}_array.h")

add_custom_command(
	OUTPUT ${C_BIN_ARRAY_C} ${C_BIN_ARRAY_H}
	COMMAND ${PYTHON_EXECUTABLE} ${BIN2C_SCRIPT} ${JSON_BIN} ${VAR_NAME} -o ${LMT_GEN_C_DIR}
	DEPENDS ${JSON_BIN} ${BIN2C_SCRIPT}
	COMMENT "Generating C array source and header from ${JSON_BIN}"
	VERBATIM
)

add_custom_target(generate_c_array ALL DEPENDS ${C_BIN_ARRAY_C} ${C_BIN_ARRAY_H})
add_dependencies(generate_c_array generate_json_bin)

# 3. Include generated .c file in your build
set(LMTSDK_GEN_SOURCES
	${LMT_DDT_FS_C}
	${C_BIN_ARRAY_C}
)
target_sources(app PRIVATE ${LMTSDK_GEN_SOURCES})
target_include_directories(app PRIVATE ${LMT_GEN_C_DIR})
add_dependencies(app generate_c_array)

FILE(GLOB app_sources src/*.c)
target_sources(app PRIVATE ${app_sources})
target_link_libraries(app PRIVATE lmtSDK)
```

## Kconfig
```
#
# Copyright (c) 2020 Nordic Semiconductor ASA
#
# SPDX-License-Identifier: LicenseRef-Nordic-5-Clause
#
rsource "../../Kconfig"

config DATA_STORAGE_ON_FS
    bool "Enable the data saving on external flash"
    default n

menu "Zephyr Kernel"
source "Kconfig.zephyr"
endmenu
```

## sysbuild.conf
```
SB_CONFIG_BOOTLOADER_MCUBOOT=y
SB_CONFIG_PARTITION_MANAGER=y
SB_CONFIG_PM_EXTERNAL_FLASH_MCUBOOT_SECONDARY=n
SB_CONFIG_MCUBOOT_MODE_OVERWRITE_ONLY=y
SB_CONFIG_BOOT_SIGNATURE_TYPE_RSA=y
```

## prj.conf
```kconfig
CONFIG_LMTSDK=y
```

## src/main.c
```c
#include <zephyr/kernel.h>
#include "lmt_sdk_api.h"

#if defined(CONFIG_COAP_QUEUE_SIZE)
#define MAX_COUNT_OF_COAP_REQUESTS CONFIG_COAP_QUEUE_SIZE
#else
#define MAX_COUNT_OF_COAP_REQUESTS 96
#endif

// Substitutes
uint8_t coap_queue[MAX_COUNT_OF_COAP_REQUESTS * APP_COAP_MAX_MSG_LEN];
const unsigned int coap_queue_size = MAX_COUNT_OF_COAP_REQUESTS * APP_COAP_MAX_MSG_LEN;

void setup(void)
{
    logInfo("Setup function called");
}

void loop(void)
{
    logWarning("Loop function called");
    k_sleep(K_FOREVER);
}

int main(void)
{
    enableSerialLog();
    lmtInit();
    setup();
    logInfo("Hello World!");
    // disableSerialLog();
    logInfo("Serial log should be disabled, this won't be printed");
    while(1)
    {
        loop();
    }
    return 0;
}
```
