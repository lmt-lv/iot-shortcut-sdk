## CMakeLists.txt
```
#
# Copyright (c) 2025 LMT
#

cmake_minimum_required(VERSION 3.20.0)

# Include lmtSDK
set(EXTRA_ZEPHYR_MODULES "${CMAKE_CURRENT_SOURCE_DIR}/../..")

find_package(Zephyr REQUIRED HINTS $ENV{ZEPHYR_BASE})

project(lmtSDK_eval_kit_sample)

FILE(GLOB app_sources src/*.c)
target_sources(app PRIVATE ${app_sources})

target_include_directories(app PRIVATE ${CMAKE_CURRENT_SOURCE_DIR}/inc)
```

## Kconfig
```
#
# Copyright (c) 2020 Nordic Semiconductor ASA
#
# SPDX-License-Identifier: LicenseRef-Nordic-5-Clause
#

menu "LMT SoM settings"

config THREAD_STACK_SIZE_512
    int "Thread stack size"
    default 512

config THREAD_STACK_SIZE_1024
    int "Thread stack size"
    default 1024

config THREAD_STACK_SIZE_2048
    int "Thread stack size"
    default 2048

config THREAD_STACK_SIZE_4096
    int "Thread stack size"
    default 4096

endmenu

module = SoM
module-str = LMT system-on-module
source "${ZEPHYR_BASE}/subsys/logging/Kconfig.template.log_config"

menu "Zephyr Kernel"
source "Kconfig.zephyr"
endmenu
```

## prj.conf
```kconfig
#
# Project configuration for Zephyr RTOS firmware
#
# This file lists all the features and settings enabled in the firmware.
# Each CONFIG_ option turns on or customizes a specific feature (such as sensors, power management, or communication).
# Lines starting with # are comments and are ignored by the build system.
#
# For example:
#   CONFIG_ADC=y      # Enable analog-to-digital converter (for reading analog sensors)
#   CONFIG_PWM=y      # Enable pulse-width modulation (for controlling outputs like LEDs)
#
# You can change these options to enable or disable features as needed.
#

# General config
CONFIG_MAIN_STACK_SIZE=2048

## Power management
CONFIG_PM_DEVICE=y

# WDT
CONFIG_WATCHDOG=y
CONFIG_WDT_DISABLE_AT_BOOT=y

# Firmware version string
CONFIG_MCUBOOT_IMGTOOL_SIGN_VERSION="1.0.3"

CONFIG_SETTINGS=y
CONFIG_SETTINGS_FCB=y
CONFIG_FCB=y

CONFIG_FPU=y

CONFIG_ADC=y

CONFIG_PWM=y
CONFIG_LED=y
CONFIG_LED_PWM=y
CONFIG_I2C=y
# Enable Zephyr sensor API
CONFIG_SENSOR=y
# LIS3DH and LIS2DH use the same driver
CONFIG_LIS2DH=y
# Enable setting output data rate and set it to 1344Hz (normal mode)
CONFIG_LIS2DH_ODR_9_NORMAL=y
# Enable setting full scale to ±16g
CONFIG_LIS2DH_ACCEL_RANGE_16G=y
```

## src/main.c
```c
/**
 * @file main.c
 * @brief Main application file for LMT SDK sample
 *
 * This file contains the main logic for reading sensor data and sending data to a server.
 *
 * Key steps and calculations are explained in comments.
 */

#include "adc_pwm.h"         // For reading potentiometer and controlling PWM
#include "app_status_bits.h" // For tracking system startup status
#include "bmp.h"             // For reading pressure and temperature from BMP390 sensor
#include "lis3dh.h"          // For reading acceleration from LIS3DH sensor
#include "lmt_sdk_app.h"     // Main application header (includes core SDK and command handler)

// Thread priorities: lower number = higher priority
#define PRIORITY_LIS3DH  1 // High priority for accelerometer task
#define PRIORITY_ADC_PWM 6 // Lower priority for ADC/PWM task

// Indices for storing sensor data in the Data array
#define BRIGHTNESS_INDEX   0 // Potentiometer (knob) position
#define TEMPERATURE_INDEX  1 // Temperature from BMP390
#define PRESSURE_INDEX     2 // Pressure from BMP390
#define ACCELARATION_INDEX 3 // Maximum acceleration from LIS3DH

#define DATA_READ_PERIOD 300 // Data read period in seconds (5 minutes)

// Define stack memory for the threads (required by Zephyr)
K_THREAD_STACK_DEFINE(lis3dh_stack_area, 1024);  // Stack for LIS3DH thread
K_THREAD_STACK_DEFINE(adc_pwm_stack_area, 1024); // Stack for ADC/PWM thread

// Thread data structures (used to manage threads)
static struct k_thread lis3dh_thread_data;
static struct k_thread adc_pwm_thread_data;

// This function is required to avoid linker errors (even if not used directly)
void force_link_k_msgq_put(struct k_msgq *q, void *data, k_timeout_t t)
{
    k_msgq_put(q, data, t);
}

/**
 * @brief Application setup/init code
 *
 * This function sets up the system, initializes BMP390 sensor, and starts background tasks
 * (threads). It also sets a status bit to indicate the main application started successfully.
 */
void appInit(void)
{
    int err = 0;

    // Set the boot OK mask: when all required modules are initialized,
    // the system will generate an EVENT_DEVICE_INIT_OK event.
    setUserBootOkMask(APP_BOOT_OK);

    // Initialize the BMP390 sensor (for pressure and temperature)
    err = bmp390Init();
    if(err)
    {
        logError("BMP390 init failed, err: %d", err);
        return;
    }

    // Start the LIS3DH accelerometer task in its own thread
    k_thread_create(&lis3dh_thread_data, lis3dh_stack_area,
                    K_THREAD_STACK_SIZEOF(lis3dh_stack_area), lis3dhTask, NULL, NULL, NULL,
                    PRIORITY_LIS3DH, 0, K_NO_WAIT);

    // Start the ADC/PWM task in its own thread
    k_thread_create(&adc_pwm_thread_data, adc_pwm_stack_area,
                    K_THREAD_STACK_SIZEOF(adc_pwm_stack_area), adcPwmTask, NULL, NULL, NULL,
                    PRIORITY_ADC_PWM, 0, K_NO_WAIT);

    // Indicate that the main application has started successfully
    setBootOkBit(MAIN_BOOT_OK_BIT);
}

/**
 * @brief Event callback functions
 *
 * The SDK uses an event-driven architecture where each SOM event has a corresponding callback
 * function. Users implement only the callbacks they need to handle specific events.
 *
 * Event naming pattern: EVENT_DEVICE_INIT_OK -> onDeviceInitOk (remove "EVENT_" prefix, camelCase)
 * Full list of available events is in `lmt_som_event_emitter.h`.
 *
 * To handle an event, simply implement its callback function with the signature:
 *   void onEventName(void *p_data, int i_data)
 *
 * Unimplemented callbacks are ignored by the SDK.
 */
void onDeviceInitOk(void *p_data, int i_data)
{
    logInfo("All system parts initialized successfully");
}

void onTerminalCmd(void *p_data, int i_data)
{
    // Perform the requested command and send the result
    sendEventCmdRes(runTerminalCmd(p_data, i_data));
}

/**
 * @brief Read sensor data and record it for transmission.
 *
 * This function reads all sensor values (potentiometer, temperature, pressure, acceleration),
 * stores them in an array, and prepares them for sending to the server.
 *
 * The data is packed and added to a buffer ("tape"). When the buffer is full, the data is sent or
 * when uplink timeout occurs.
 */
void readAndRecordData(void)
{
    int error                      = 0;
    int32_t Data[MAX_TRACKS_COUNT] = {0}; // Array to hold all sensor data
    uint32_t pressure              = 0;
    int32_t temperature            = 0;
    float accelaration_max         = 0;
    unsigned brightness            = 0;

    // Read temperature and pressure from BMP390 sensor. Temperature is in °C x 100, pressure in Pa.
    error = bmp390ReadPressureAndTemperature(&pressure, &temperature);
    if(error)
    {
        logError("BMP390 read failed, err: %d", error);
    }

    // Read maximum acceleration from LIS3DH sensor
    readLis3dhMax(&accelaration_max);
    // Read potentiometer (knob) position as a percentage
    readPotPosition(&brightness);

    // Print all read values
    logInfoFormatted("Pot: %d%%, Temp: %d.%02d C, Pressure: %d Pa, Accel max: %.2f m/s^2",
                     brightness, temperature / 100, temperature % 100, pressure, accelaration_max);

    // Store sensor data in the Data array
    Data[BRIGHTNESS_INDEX]  = brightness;  // Potentiometer position (0-100%)
    Data[TEMPERATURE_INDEX] = temperature; // Temperature (°C x 100)
    Data[PRESSURE_INDEX]    = pressure;    // Pressure (Pa)
    // Multiply acceleration by 100 to keep two decimal places
    Data[ACCELARATION_INDEX] = (int32_t)(accelaration_max * 100); // Acceleration (m/s^2 x 100)

    // Add the data to the tape (buffer for sending)
    error = addColumnToTape(I_TAPE, DATA_READ_PERIOD, Data);
    if(error == 0)
    {
        // If the buffer is full, trigger data packing (prepares data for sending)
        triggerDataPacking(false); // No radio data
    }
    else if(error < 0)
    {
        logError("Could not add measurement to tape", error);
        return;
    }
}

/**
 * @brief Main application entry point
 *
 * This is where the program starts running. It initializes the SDK and user application,
 * then enters a loop to periodically read sensor data and record it for transmission.
 *
 * The loop waits for a fixed period (DATA_READ_PERIOD), reads all sensor data, and repeats.
 *
 * @return Returns error code (should never return in normal operation)
 */
int main(void)
{
    int64_t start_tick = 0;
    int64_t end_tick   = 0;

    // Set uplink period in minutes(how often data is sent to server)
    setUplinkTimeout(5);
    // Initialize the LMT SDK (sets up core system functions)
    lmtInit();
    // Initialize the user application (sensors, threads, etc.)
    appInit();

    // Main loop: read and record data every DATA_READ_PERIOD seconds
    while(1)
    {
        // Wait for the next data read period (adjusted for time spent processing)
        k_sleep(K_SECONDS(DATA_READ_PERIOD - (end_tick - start_tick) / 1000));

        start_tick = k_uptime_get();
        readAndRecordData();
        end_tick = k_uptime_get();
    }

    return 0;
}
```

## inc/adc_pwm.h
```c
/**
 * @file adc_pwm.h
 * @brief Interface for reading potentiometer position and controlling PWM output
 *
 * This header provides functions to:
 *   - Read the position of a potentiometer (knob) using the ADC (Analog-to-Digital Converter)
 *   - Run a background task that continuously reads the potentiometer and sets PWM output
 * accordingly
 *
 * The potentiometer position is always given as a percentage (0% to 100%).
 */

#ifndef ADC_PWM_H
#define ADC_PWM_H

/**
 * @brief Read the potentiometer position as a percentage (0-100%).
 *
 * This function measures the position of a knob (potentiometer) and converts it to a percentage
 * value.
 *
 * @param position Pointer to an unsigned integer where the result (percentage) will be stored.
 */
void readPotPosition(unsigned *position);

/**
 * @brief Task to read ADC value, calculate potentiometer position, and set PWM output.
 *
 * This function is intended to run as a background task. It repeatedly:
 *   - Reads the analog value from the potentiometer using the ADC
 *   - Calculates the position as a percentage (0-100%)
 *   - Sets the PWM output to match the potentiometer position
 *
 * The arguments (arg1, arg2, arg3) are not used.
 *
 * @param arg1 Unused
 * @param arg2 Unused
 * @param arg3 Unused
 */
void adcPwmTask(void *arg1, void *arg2, void *arg3);

#endif // ADC_PWM_H
```

## inc/app_status_bits.h
```c
/**
 * @file app_status_bits.h
 * @brief Defines status bits for tracking system startup success.
 *
 * This header provides macros to represent the startup status of different modules in the
 * application. Each module (main application, ADC/PWM, LIS3DH sensor) has a unique "boot OK" bit.
 * These bits are used to check if each part of the system started successfully.
 *
 * For example, if the ADC and PWM initialize correctly, ADC_PWM_BOOT_OK_BIT is set.
 *
 * This makes it easy to check system health and diagnose startup issues.
 */

#ifndef APP_STATUS_BITS_H
#define APP_STATUS_BITS_H

// Boot OK bits and values

// Each "BOOT_OK_BIT" is a unique number used to represent whether a part of the system started
// successfully. These bits are used to track the status of different modules during system startup.
//
// For example, if the ADC and PWM initialize correctly, ADC_PWM_BOOT_OK_BIT is set.

// Main application boot OK bit: set when the main application starts successfully
#define MAIN_BOOT_OK_BIT FIRST_USER_STATUS_BIT
// Value with only the MAIN_BOOT_OK_BIT set (used for status checking)
#define MAIN_BOOT_OK_VAL BIT(MAIN_BOOT_OK_BIT)

// ADC/PWM boot OK bit: set when ADC and PWM modules initialize successfully
#define ADC_PWM_BOOT_OK_BIT (FIRST_USER_STATUS_BIT + 1)
// Value with only the ADC_PWM_BOOT_OK_BIT set
#define ADC_PWM_BOOT_OK_VAL BIT(ADC_PWM_BOOT_OK_BIT)

// LIS3DH boot OK bit: set when the LIS3DH accelerometer initializes successfully
#define LIS3DH_BOOT_OK_BIT (FIRST_USER_STATUS_BIT + 2)
// Value with only the LIS3DH_BOOT_OK_BIT set
#define LIS3DH_BOOT_OK_VAL BIT(LIS3DH_BOOT_OK_BIT)

// APP_BOOT_OK is a combination of all the above values.
// If APP_BOOT_OK is set, it means all modules (main, ADC/PWM, LIS3DH) started successfully.
#define APP_BOOT_OK (MAIN_BOOT_OK_VAL | ADC_PWM_BOOT_OK_VAL | LIS3DH_BOOT_OK_VAL)

#endif // APP_STATUS_BITS_H
```

## inc/lis3dh.h
```c
/**
 * @file lis3dh.h
 * @brief Interface for reading acceleration from the LIS3DH sensor
 *
 * This header provides functions to:
 *   - Read the maximum acceleration measured by the LIS3DH sensor
 *   - Run a background task that continuously reads and stores the maximum acceleration
 *
 * Acceleration values are given in units of g (gravitational acceleration, where 1g ≈ 9.81 m/s²).
 *
 * These functions are designed to be easy to use and understand, even for those without a
 * programming background.
 */

#ifndef LIS3DH_H
#define LIS3DH_H

/**
 * @brief Get the maximum acceleration value measured by the LIS3DH sensor.
 *
 * This function returns the highest acceleration value (in m/s^2) measured since the last reset.
 *
 * @param max Pointer to a float where the maximum acceleration (in m/s^2) will be stored.
 */
void readLis3dhMax(float *max);

/**
 * @brief Task to read LIS3DH sensor, calculate maximum acceleration, and store it.
 *
 * This function is intended to run as a background task. It repeatedly:
 *   - Reads acceleration data from the LIS3DH sensor
 *   - Calculates the magnitude (modulus) of the acceleration vector
 *   - Stores the maximum value found
 *
 * The arguments (arg1, arg2, arg3) are not used.
 *
 * @param arg1 Unused
 * @param arg2 Unused
 * @param arg3 Unused
 */
void lis3dhTask(void *arg1, void *arg2, void *arg3);

#endif // LIS3DH_H
```

## inc/lmt_sdk_app.h
```c
/**
 * @file lmt_sdk_app.h
 * @brief Main application header. Includes core API and terminal command handler interfaces.
 *
 * This header aggregates the main SDK API and terminal command handler for use in the application.
 */
#ifndef LMT_SDK_APP_H
#define LMT_SDK_APP_H

#include "lmt_sdk_api.h"

#include "terminal_cmd_handler.h"

#endif // LMT_SDK_APP_H
```

## src/adc_pwm.c
```c
/*
 * adc_pwm.c
 *
 * This file provides functions to:
 *   - Read the position of a potentiometer (knob) using the ADC (Analog-to-Digital Converter)
 *   - Set the PWM (Pulse Width Modulation) output based on the potentiometer position
 *
 * The potentiometer position is always given as a percentage (0% to 100%).
 *
 * Key steps and calculations are explained in comments.
 */

#include "adc_pwm.h"
#include "app_status_bits.h"     // For setting boot OK mask
#include "lmt_common.h"          // For common definitions
#include "lmt_storage_manager.h" // For log functions
#include <zephyr/drivers/adc.h>
#include <zephyr/drivers/pwm.h>

// PWM configuration: Use the device tree alias 'pwm_led0' for the PWM output
#define PWM_LED0 DT_ALIAS(pwm_led0)

// ADC and PWM device structures
// These hold configuration for the ADC channel and PWM output, using device tree macros
static const struct adc_dt_spec adc_channel = ADC_DT_SPEC_GET(DT_PATH(zephyr_user));
static const struct pwm_dt_spec pwm_led0    = PWM_DT_SPEC_GET(PWM_LED0);

// Buffer to store the raw ADC reading
static int32_t buf;
// ADC sequence configuration: tells the ADC driver where to put the result
struct adc_sequence sequence = {
    .buffer      = &buf,
    .buffer_size = sizeof(buf),
    // .calibrate = true, // Optional: enable calibration if needed
};

// The maximum expected ADC voltage in millivolts (mV). Setting a bit below the actual VDD to allow
// actual readings to set the maximum
static uint32_t max_adc_mv = 3525;
// The potentiometer position as a percentage (0-100%) of the maximum ADC value
static int adc_perc = 0;

/**
 * @brief Initialize the ADC (Analog-to-Digital Converter).
 *
 * Prepares the ADC hardware to read analog values from the potentiometer.
 *
 * @return 0 on success, negative error code on failure
 */
int initAdc(void)
{
    int error = 0;
    // Check if the ADC device is ready
    if(!adc_is_ready_dt(&adc_channel))
    {
        logWarning("ADC controller device not ready");
        return -ENODEV;
    }

    // Set up the ADC channel
    error = adc_channel_setup_dt(&adc_channel);
    if(error < 0)
    {
        logWarning("Could not setup channel");
        return error;
    }

    // Initialize the ADC sequence (where to store the result)
    error = adc_sequence_init_dt(&adc_channel, &sequence);
    if(error < 0)
    {
        logWarning("Could not initialize sequence");
        return error;
    }

    logInfo("ADC sequence initialized");

    return 0;
}

/**
 * @brief Initialize the PWM (Pulse Width Modulation) output.
 *
 * Prepares the PWM hardware to control an output (such as an LED or motor) based on the
 * potentiometer position.
 *
 * @return 0 on success, negative error code on failure
 */
int initPwm(void)
{
    int error = 0;
    // Check if the PWM device is ready
    if(!pwm_is_ready_dt(&pwm_led0))
    {
        logWarning("Error: PWM device is not ready");
        return -ENODEV;
    }

    logInfo("PWM device is ready");

    // Set initial PWM duty cycle to 0 (output off)
    error = pwm_set_dt(&pwm_led0, max_adc_mv, 0);
    if(error)
    {
        logWarning("Could not set PWM duty cycle");
    }

    return error;
}

/**
 * @brief Get the current potentiometer position as a percentage (0-100%).
 *
 * @param position Pointer to an unsigned integer where the result will be stored.
 */
void readPotPosition(unsigned *position)
{
    if(position != NULL)
    {
        *position = adc_perc;
    }
}

/**
 * @brief Task to read potentiometer position and set PWM output.
 *
 * This function runs in a loop:
 *   - Reads the analog value from the potentiometer using the ADC
 *   - Converts the value to millivolts (mV)
 *   - Calculates the position as a percentage (0-100%)
 *   - Sets the PWM output to match the potentiometer position
 *   - Waits for 1 second before repeating
 *
 * If the ADC or PWM initialization fails, an error is logged.
 *
 * @param arg1 Unused
 * @param arg2 Unused
 * @param arg3 Unused
 */
void adcPwmTask(void *arg1, void *arg2, void *arg3)
{
    int error = 0;
    int adc_error, pwm_error;
    // ADC value in millivolts
    int32_t adc_mv = 0;

    adc_error = initAdc();
    if(adc_error)
    {
        logError("ADC init failed", adc_error);
    }

    pwm_error = initPwm();
    if(pwm_error)
    {
        logError("PWM init failed", pwm_error);
    }

    // Only set the boot OK bit if both ADC and PWM were initialized successfully
    if(!adc_error && !pwm_error)
    {
        setBootOkBit(ADC_PWM_BOOT_OK_BIT);
    }

    while(1)
    {
        // Read ADC value (raw)
        error = adc_read(adc_channel.dev, &sequence);
        if(error < 0)
        {
            logError("Could not read ADC value", error);
            continue;
        }

        // Filter negative readings (can happen due to hardware effects)
        if((int16_t)buf < 0)
        {
            buf = 0;
        }

        // Store the raw ADC value
        adc_mv = buf;

        // Convert raw ADC value to millivolts (mV)
        error = adc_raw_to_millivolts_dt(&adc_channel, &adc_mv);
        if(error < 0)
        {
            logWarning(" (value in mV not available)");
        }

        // If the measured voltage is higher than expected, update the maximum (power supplies
        // aren't perfect)
        if(adc_mv > max_adc_mv)
        {
            max_adc_mv = adc_mv;
        }

        // Clamp negative values to zero (can happen due to hardware effects)
        if(adc_mv < 0)
        {
            adc_mv = 0;
        }

        // Calculate potentiometer position as a percentage of the maximum
        // Rounds up if halfway between two values
        adc_perc = ((adc_mv * 100) + (max_adc_mv / 2)) / max_adc_mv;

        // Uncomment to print potentiometer reading in percent
        // logInfoFormatted("Potentiometer value in %% of max: %d%%", adc_perc);

        // Set PWM output based on potentiometer position
        error = pwm_set_dt(&pwm_led0, max_adc_mv, adc_mv);
        if(error)
        {
            logError("Error in pwm_set_dt()", error);
            continue;
        }

        k_sleep(K_SECONDS(1)); // Wait for 1 second before next reading
    }
}
```

## src/bmp.c
```c
/*
 * BMP390 Sensor Driver (Bosch Sensortec)
 *
 * This file provides functions to initialize and read data from the BMP390 pressure and temperature
 * sensor over I2C.
 *
 * The BMP390 is a digital barometric pressure and temperature sensor. It is used to measure
 * atmospheric pressure (in Pascals) and temperature (in degrees Celsius). The sensor requires
 * calibration and compensation to convert raw readings into accurate values.
 *
 * All pressure values returned are in Pascals (Pa), and temperature values are in hundredths of
 * degrees Celsius (°C × 100).
 *
 * Functions in this file:
 *  - Initialize the sensor
 *  - Read and compensate raw sensor data
 *  - Return accurate pressure and temperature values
 *
 * Key steps and calculations are explained in comments.
 */

#include "bmp.h"
#include "lmt_storage_manager.h" // For log functions
#include <zephyr/drivers/i2c.h>
#include <zephyr/sys/byteorder.h>

// BMP390 datasheet:
// https://www.bosch-sensortec.com/media/boschsensortec/downloads/datasheets/bst-bmp390-ds002.pdf
// Register addresses used to communicate with the BMP390 sensor
#define BMP390_REG_CHIP_ID  0x00 // Register to read the sensor's chip ID (should be 0x60)
#define BMP390_REG_STATUS   0x03 // Status register
#define BMP390_REG_DATA_0   0x04 // Start of pressure/temperature data registers
#define BMP390_REG_PWR_CTRL 0x1B // Power control register
#define BMP390_REG_OSR      0x1C // Oversampling settings register
#define BMP390_REG_ODR      0x1D // Output data rate register
#define BMP388_REG_CALIB0   0x31 // Start of calibration data registers
#define BMP390_REG_CMD      0x7E // Command register (e.g., for soft reset)

// BMP390 commands and configuration values
#define BMP390_CMD_SOFT_RESET  0xB6 // Command to reset the sensor
#define BMP390_CHIP_ID         0x60 // Expected chip ID value for BMP390
#define BMP390_PWR_CTRL_ENABLE 0x33 // Enable pressure, temperature, and normal mode
#define BMP390_OSR_DEFAULT     0x1B // 8x oversampling for both pressure and temperature
#define BMP390_ODR_DEFAULT     0x07 // Output data rate: 640 ms sampling period

// Structure to hold calibration data read from the sensor.
// These values are used to convert raw sensor readings into accurate pressure and temperature.
struct bmp390_cal_data
{
    uint16_t t1;
    uint16_t t2;
    int8_t t3;
    int16_t p1;
    int16_t p2;
    int8_t p3;
    int8_t p4;
    uint16_t p5;
    uint16_t p6;
    int8_t p7;
    int8_t p8;
    int16_t p9;
    int8_t p10;
    int8_t p11;
} __packed;

// I2C device pointer for BMP390 sensor (configured via device tree)
static const struct i2c_dt_spec bmp_i2c = I2C_DT_SPEC_GET(DT_NODELABEL(bmp390));
// Calibration data storage
static struct bmp390_cal_data calib_data;
// Variable to store compensated temperature (needed for pressure calculation)
static int64_t compensated_t_for_p;

/**
 * @brief Wake up BMP390 sensor by sending a dummy byte over I2C.
 *
 * This function ensures the sensor is ready to communicate. It tries up to 10 times.
 *
 * @return true if the sensor responded, false otherwise
 */
bool wakeupBmp()
{
    int error      = 0;
    int attemps    = 10;
    uint8_t byte_0 = 0x77; // Dummy value to wake up the sensor

    if(!device_is_ready(bmp_i2c.bus))
    {
        logWarning("i2c bus not ready");
        return false;
    }

    // Try to write until the sensor responds or attempts run out
    do
    {
        error = i2c_write_dt(&bmp_i2c, &byte_0, 1);
    } while((error < 0) && (--attemps > 0));

    if(error == 4)
    {
        logWarning("BMP waikeup failed");
        return false;
    }

    return (attemps > 0);
}

/**
 * @brief Read calibration data from BMP390 sensor.
 *
 * The sensor stores factory calibration values in its memory. These are needed to convert raw
 * readings into accurate pressure and temperature values.
 *
 * @return 0 on success, negative error code on failure
 */
int readCalibData(void)
{
    int error            = 0;
    uint8_t read_address = BMP388_REG_CALIB0;

    // Read calibration data from 0x31 to 0x45 (20 bytes)
    error = i2c_write_read_dt(&bmp_i2c, &read_address, sizeof(read_address), &calib_data,
                              sizeof(calib_data));
    if(error < 0)
    {
        logWarning("BMP390: Failed to read calibration data");
        return error;
    }

    // Convert from little-endian to CPU endianness if necessary
    calib_data.t1 = sys_le16_to_cpu(calib_data.t1);
    calib_data.t2 = sys_le16_to_cpu(calib_data.t2);
    calib_data.p1 = sys_le16_to_cpu(calib_data.p1);
    calib_data.p2 = sys_le16_to_cpu(calib_data.p2);
    calib_data.p5 = sys_le16_to_cpu(calib_data.p5);
    calib_data.p6 = sys_le16_to_cpu(calib_data.p6);
    calib_data.p9 = sys_le16_to_cpu(calib_data.p9);

    return 0;
}

/**
 * @brief Convert raw temperature value to real temperature using calibration data.
 *
 * The sensor provides a raw temperature value. This function uses calibration data to
 * "compensate" (correct) the value, so it matches the real temperature.
 *
 * @param raw_temp Raw temperature value from sensor
 * @return Compensated temperature in hundredths of degrees Celsius (°C × 100)
 */
int32_t bmp390CompensateTemp(uint32_t raw_temp)
{
    // The following calculations are based on the official Bosch BMP3-Sensor-API.
    // Adapted from: https://github.com/BoschSensortec/BMP3-Sensor-API/blob/master/bmp3.c
    int64_t partial_data1;
    int64_t partial_data2;
    int64_t partial_data3;
    int64_t partial_data4;
    int64_t partial_data5;

    // Step-by-step calculation for temperature compensation
    partial_data1 = ((int64_t)raw_temp - (256 * calib_data.t1));
    partial_data2 = calib_data.t2 * partial_data1;
    partial_data3 = (partial_data1 * partial_data1);
    partial_data4 = (int64_t)partial_data3 * calib_data.t3;
    partial_data5 = ((int64_t)(partial_data2 * 262144) + partial_data4);

    // Store intermediate result for use in pressure compensation
    compensated_t_for_p = partial_data5 / 4294967296;

    // Final temperature value in hundredths of a degree Celsius
    int64_t tmp = ((compensated_t_for_p * 250000) / 16384) / 10000;

    return (int32_t)tmp;
}

/**
 * @brief Convert raw pressure value to real pressure using calibration data.
 *
 * The sensor provides a raw pressure value. This function uses calibration data and the previously
 * compensated temperature to "compensate" (correct) the value, so it matches the real atmospheric
 * pressure.
 *
 * @param raw_pressure Raw pressure value from sensor
 * @return Compensated pressure in Pascals (Pa)
 */
int64_t bmp390CompensatePressure(uint32_t raw_pressure)
{
    /*
     * The following calculations are based on the official Bosch BMP3-Sensor-API.
     * Adapted from: https://github.com/BoschSensortec/BMP3-Sensor-API/blob/master/bmp3.c
     */
    int64_t partial_data1;
    int64_t partial_data2;
    int64_t partial_data3;
    int64_t partial_data4;
    int64_t partial_data5;
    int64_t partial_data6;
    int64_t offset;
    int64_t sensitivity;
    uint64_t comp_press;

    int64_t t_lin = compensated_t_for_p; // Use compensated temperature

    // Step-by-step calculation for pressure compensation
    partial_data1 = t_lin * t_lin;
    partial_data2 = partial_data1 / 64;
    partial_data3 = (partial_data2 * t_lin) / 256;
    partial_data4 = (calib_data.p8 * partial_data3) / 32;
    partial_data5 = (calib_data.p7 * partial_data1) * 16;
    partial_data6 = (calib_data.p6 * t_lin) * 4194304;
    offset = (calib_data.p5 * 140737488355328) + partial_data4 + partial_data5 + partial_data6;
    partial_data2 = (calib_data.p4 * partial_data3) / 32;
    partial_data4 = (calib_data.p3 * partial_data1) * 4;
    partial_data5 = (calib_data.p2 - 16384) * t_lin * 2097152;
    sensitivity =
        ((calib_data.p1 - 16384) * 70368744177664) + partial_data2 + partial_data4 + partial_data5;
    partial_data1 = (sensitivity / 16777216) * raw_pressure;
    partial_data2 = calib_data.p10 * t_lin;
    partial_data3 = partial_data2 + (65536 * calib_data.p9);
    partial_data4 = (partial_data3 * raw_pressure) / 8192;
    // The next two lines avoid overflow in multiplication
    partial_data5 = (raw_pressure * (partial_data4 / 10)) / 512;
    partial_data5 = partial_data5 * 10;
    partial_data6 = ((int64_t)raw_pressure * (int64_t)raw_pressure);
    partial_data2 = (calib_data.p11 * partial_data6) / 65536;
    partial_data3 = (partial_data2 * raw_pressure) / 128;
    partial_data4 = (offset / 4) + partial_data1 + partial_data5 + partial_data3;

    // Final pressure value in hundredths of Pascals, so divide by 100 to get Pascals
    comp_press = (((uint64_t)partial_data4 * 25) / (uint64_t)1099511627776);
    comp_press /= 100;

    return comp_press;
}

/**
 * @brief Initialize the BMP390 sensor for use.
 *
 * This function wakes up the sensor, resets it, checks its identity, sets up oversampling and data
 * rate, reads calibration data, and enables normal measurement mode.
 *
 * @return 0 on success, negative error code on failure
 */
int bmp390Init(void)
{
    int error       = 0;
    uint8_t chip_id = 0;
    uint8_t data[2] = {0};

    wakeupBmp();
    // Soft reset the sensor to ensure it starts from a known state
    data[0] = BMP390_REG_CMD;
    data[1] = BMP390_CMD_SOFT_RESET;
    error   = i2c_write_dt(&bmp_i2c, data, 2);
    if(error < 0)
    {
        logWarning("BMP390: Soft reset failed");
        return error;
    }

    k_msleep(10); // Wait for reset to complete
    wakeupBmp();
    // Check that the sensor is really a BMP390 by reading its chip ID
    data[0] = BMP390_REG_CHIP_ID;
    error   = i2c_write_read_dt(&bmp_i2c, data, 1, &chip_id, 1);

    if(error != 0 || chip_id != BMP390_CHIP_ID)
    {
        logWarning("BMP390: Invalid chip ID: 0x%02x");
        return -chip_id;
    }

    // Set oversampling (improves accuracy)
    data[0] = BMP390_REG_OSR;
    data[1] = BMP390_OSR_DEFAULT;
    error   = i2c_write_dt(&bmp_i2c, data, 2);
    if(error < 0)
    {
        logWarning("BMP390: Failed to set oversampling");
        return error;
    }

    // Set output data rate (how often sensor measures)
    data[0] = BMP390_REG_ODR;
    data[1] = BMP390_ODR_DEFAULT;
    error   = i2c_write_dt(&bmp_i2c, data, 2);
    if(error < 0)
    {
        logWarning("BMP390: Failed to set output data rate");
        return error;
    }

    // Read calibration data from sensor
    error = readCalibData();
    if(error < 0)
    {
        logWarning("BMP390: Failed to read calibration data");
        return error;
    }

    // Enable sensor in normal measurement mode
    data[0] = BMP390_REG_PWR_CTRL;
    data[1] = BMP390_PWR_CTRL_ENABLE;
    error   = i2c_write_dt(&bmp_i2c, data, 2);
    if(error < 0)
    {
        logWarning("BMP390: Failed to enable power control");
        return error;
    }

    logInfo("BMP390: Initialized successfully");

    return 0;
}

/**
 * @brief Read and return the current pressure and temperature from the BMP390 sensor.
 *
 * This function reads the raw sensor data, compensates it using calibration values,
 * and returns the real atmospheric pressure (in Pascals) and temperature (in °C × 100).
 *
 * @param pressure_pa Pointer to store the compensated pressure value (Pascals)
 * @param temperature Pointer to store the compensated temperature value (°C × 100)
 * @return 0 on success, negative error code on failure
 */
int bmp390ReadPressureAndTemperature(uint32_t *pressure_pa, int32_t *temperature)
{
    int error             = 0;
    uint8_t data[6]       = {0};
    uint32_t raw_temp     = 0;
    uint32_t raw_pressure = 0;

    wakeupBmp();

    // Read 6 bytes: 3 for pressure, 3 for temperature
    data[0] = BMP390_REG_DATA_0;
    error   = i2c_write_read_dt(&bmp_i2c, data, 1, data, 6);
    if(error < 0)
    {
        logWarning("BMP390: Failed to read pressure data");
        return error;
    }

    // Convert bytes to 24-bit raw values (little-endian)
    raw_pressure = (uint32_t)data[2] << 16 | (uint32_t)data[1] << 8 | data[0];
    raw_temp     = (uint32_t)data[5] << 16 | (uint32_t)data[4] << 8 | data[3];

    // Compensate raw values to get real temperature and pressure
    *temperature = bmp390CompensateTemp(raw_temp);
    *pressure_pa = bmp390CompensatePressure(raw_pressure);

    return 0;
}
```

## src/lis3dh.c
```c
/*
 * lis3dh.c
 *
 * This file provides functions to:
 *   - Initialize the LIS3DH accelerometer sensor
 *   - Read the latest acceleration data from the LIS3DH sensor
 *   - Track and retrieve the maximum acceleration measured since the last reset
 *   - Run a background task that continuously reads and processes acceleration data
 *
 * Acceleration values are given in units of g (gravitational acceleration, where 1g ≈ 9.81 m/s²).
 *
 * The code is designed to be understandable for non-programmers. Key steps and calculations are
 * explained in comments.
 */

#include "lis3dh.h"
#include "app_status_bits.h"     // For setting boot OK bit
#include "lmt_common.h"          // For common definitions
#include "lmt_storage_manager.h" // For log functions
#include <math.h>
#include <zephyr/drivers/sensor.h>

// Pointer to the LIS3DH accelerometer device (configured via device tree)
static const struct device *lis3dh = DEVICE_DT_GET(DT_NODELABEL(lis3dh));
// Buffer to store acceleration data for X, Y, Z axes
static struct sensor_value accel[3] = {0};
// Maximum acceleration measured since last reset (in m/s^2)
static float max_accel = 0.0f;

/**
 * @brief Initialize the LIS3DH accelerometer sensor.
 *
 * Checks if the sensor is ready to use.
 *
 * @return 0 on success, negative error code on failure
 */
int initLis3dh(void)
{
    // Check if the LIS3DH device is ready to use
    if(!device_is_ready(lis3dh))
    {
        logWarning("LIS3DH device not ready");
        return -ENODEV;
    }

    // Initialization successful
    return 0;
}

/**
 * @brief Read the latest acceleration data from the LIS3DH sensor.
 *
 * Fetches a new sample and stores the X, Y, Z acceleration values in the accel array.
 */
void readLis3dh(void)
{
    int error = 0;

    // Fetch a new sample from the sensor
    error = sensor_sample_fetch(lis3dh);
    if(error)
    {
        logWarning("Failed to fetch LIS3DH sample");
    }

    // Get the X, Y, Z acceleration values
    error = sensor_channel_get(lis3dh, SENSOR_CHAN_ACCEL_XYZ, accel);
    if(error)
    {
        logWarning("Failed to get LIS3DH channel data");
    }

    return;
}

/**
 * @brief Get the maximum acceleration measured since the last reset.
 *
 * @param max Pointer to a float where the maximum acceleration (in g) will be stored.
 *            After reading, the stored maximum is reset to 0.
 */
void readLis3dhMax(float *max)
{
    if(max != NULL)
    {
        *max      = max_accel;
        max_accel = 0.0f; // Reset max after reading
    }
}

/**
 * @brief Task to continuously read LIS3DH sensor and track maximum acceleration.
 *
 * This function runs in a loop:
 *   - Reads the latest acceleration data (X, Y, Z axes)
 *   - Converts the values to floating-point numbers in m/s^2
 *   - Calculates the magnitude (modulus) of the acceleration vector
 *   - Updates the maximum value if a new peak is found
 *   - Waits 1 ms before repeating (for a 1 kHz data rate)
 *
 * The arguments (arg1, arg2, arg3) are not used.
 *
 * @param arg1 Unused
 * @param arg2 Unused
 * @param arg3 Unused
 */
void lis3dhTask(void *arg1, void *arg2, void *arg3)
{
    int error     = 0;
    float x       = 0;
    float y       = 0;
    float z       = 0;
    float modulus = 0;

    // Only set the boot OK bit if LIS3DH initialization succeeded
    error = initLis3dh();
    if(error)
    {
        logError("LIS3DH init failed, error: %d", error);
    }
    else
    {
        setBootOkBit(LIS3DH_BOOT_OK_BIT);
    }

    // Let the sensor stabilize for 100 ms after initialization
    k_sleep(K_MSEC(100));

    while(1)
    {
        readLis3dh(); // Read new data into accel array
        // Convert sensor values to floating-point (in m/s^2)
        x = accel[0].val1 + accel[0].val2 / 1000000.0f;
        y = accel[1].val1 + accel[1].val2 / 1000000.0f;
        z = accel[2].val1 + accel[2].val2 / 1000000.0f;
        // Calculate the magnitude of the acceleration vector
        modulus = sqrtf(x * x + y * y + z * z);

        // Update the maximum if this reading is higher
        if(modulus > max_accel)
        {
            max_accel = modulus;
            // Uncomment to print new maximum acceleration value
            // logInfoFormatted("New LIS3DH max acceleration: %.2f m/s^2", max_accel);
        }

        // Reset values for next iteration
        modulus = 0;
        x       = 0;
        y       = 0;
        z       = 0;
        // Sleep for 1 ms (1 kHz data rate)
        k_sleep(K_MSEC(1));
    }
}
```
