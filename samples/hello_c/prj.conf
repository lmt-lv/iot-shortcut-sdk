## CMakeLists.txt
```
#
# Copyright (c) 2025 LMT
#

cmake_minimum_required(VERSION 3.20.0)

# Include lmtSDK
set(EXTRA_ZEPHYR_MODULES "${CMAKE_CURRENT_SOURCE_DIR}/../..")

find_package(Zephyr REQUIRED HINTS $ENV{ZEPHYR_BASE})

project(lmt_som_sdk_sample)

FILE(GLOB app_sources src/*.c)
target_sources(app PRIVATE ${app_sources})

target_include_directories(app PRIVATE ${CMAKE_CURRENT_SOURCE_DIR}/inc)
```

## Kconfig
```
#
# Copyright (c) 2020 Nordic Semiconductor ASA
#
# SPDX-License-Identifier: LicenseRef-Nordic-5-Clause
#

menu "LMT SoM settings"

config THREAD_STACK_SIZE_512
    int "Thread stack size"
    default 512

config THREAD_STACK_SIZE_1024
    int "Thread stack size"
    default 1024

config THREAD_STACK_SIZE_2048
    int "Thread stack size"
    default 2048

config THREAD_STACK_SIZE_4096
    int "Thread stack size"
    default 4096

config USE_USER_BUTTON
    bool "Enable the debug button"
    default n

config INPUT
    bool "Enable the INPUT" if USE_USER_BUTTON
    default y if USE_USER_BUTTON

config INPUT_GPIO_KEYS
    bool "Enable the GPIO_KEYS" if USE_USER_BUTTON
    default y if USE_USER_BUTTON

config EVENTS
    bool "Enable the user EVENTS" if USE_USER_BUTTON
    default y

config DATA_STORAGE_ON_FS
    bool "Enable the data saving on external flash"
    default n

config ARDUINO_STYLE
    bool "Programm in Arduino style"
    default n

endmenu

module = SoM
module-str = LMT system-on-module
source "${ZEPHYR_BASE}/subsys/logging/Kconfig.template.log_config"

menu "Zephyr Kernel"
source "Kconfig.zephyr"
endmenu
```

## prj.conf
```kconfig
#
# Copyright (c) 2020 Nordic Semiconductor ASA
#
# SPDX-License-Identifier: LicenseRef-Nordic-5-Clause
#

# Enable SDK
CONFIG_LMTSDK=y

# General config
CONFIG_MAIN_STACK_SIZE=1024

## Power management
CONFIG_PM_DEVICE=y

# WDT
CONFIG_WATCHDOG=y
CONFIG_WDT_DISABLE_AT_BOOT=y

# Firmware version string
CONFIG_MCUBOOT_IMGTOOL_SIGN_VERSION="0.1.0"
```

## src/main.c
```c
#include "lmt_sdk_app.h"

// Feel free to edit the following file content

#define MAIN_BOOT_OK_BIT FIRST_USER_STATUS_BIT  // This bit in this app indicates that app is up and running
#define MAIN_BOOT_OK_VAL BIT(MAIN_BOOT_OK_BIT)  // Define the corresponding bit mask value

#define MAILER_LOOP_TIME K_MINUTES(3)

/**
 * @brief Application setup/init code
 */
void usrInit(void)
{
    // Set app boot ok mask: when all bits in mask are set,
    // the EVENT_DEVICE_INIT_OK for somEventHandler will be generated
    setUserBootOkMask(MAIN_BOOT_OK_VAL);

    // Leave a note in log that system's up and running
    setBootOkBit(MAIN_BOOT_OK_BIT);
}

/**
 * @brief Event callback functions
 *
 * The SDK uses an event-driven architecture where each SOM event has a corresponding callback
 * function. Users implement only the callbacks they need to handle specific events.
 *
 * Event naming pattern: EVENT_DEVICE_INIT_OK -> onDeviceInitOk (remove "EVENT_" prefix, camelCase)
 * Full list of available events is in `lmt_som_event_emitter.h`.
 *
 * To handle an event, simply implement its callback function with the signature:
 *   void onEventName(void *p_data, int i_data)
 *
 * Unimplemented callbacks are ignored by the SDK.
 */
void onDeviceInitOk(void *p_data, int i_data)
{
    logInfo("Hello world!");
}

void onTerminalCmd(void *p_data, int i_data)
{
    // Perform the requested command and send the result
    sendEventCmdRes(runTerminalCmd(p_data, i_data));
}

/**
 * @brief Application entry
 *
 * @return Returns error code that should be returned never
 */
int main(void)
{
    // The init order depends on the Setup called functions
    lmtInit();  // init the lmtSDK first if Setup uses lmtSDK functionality
    usrInit();  // init the application

    while(1)
    {
        k_sleep(MAILER_LOOP_TIME);
        triggerMailer(true);
    }

    return 0;
}
```

## inc/terminal_cmd_handler.h
```c
#ifndef TERMINAL_CMD_HANDLER_H
#define TERMINAL_CMD_HANDLER_H

#include <stdint.h>

/**
 * @brief Runs the command
 *
 * @return 0 on success, negative error code on fail
 */
int runTerminalCmd(uint8_t *cmd, uint8_t cmd_len);

#endif // TERMINAL_CMD_HANDLER_H
```

## src/terminal_cmd_handler.c
```c
#include "terminal_cmd_handler.h"
#include "lmt_coap_manager.h"
#include "lmt_storage_manager.h"
#include <errno.h>
#include <string.h>
#include <zephyr/sys/reboot.h>

// List of supported commands
#define CMD_ERASE_FLASH 'E'
#define CMD_LOG_STATUS  'L'
#define CMD_REBOOT      'R'

#define PRE_REBOOT_DELAY K_SECONDS(10)

int runTerminalCmd(uint8_t *cmd, uint8_t cmd_len)
{
    int err = 0;

    if(cmd == NULL || cmd_len == 0)
    {
        return -EINVAL;
    }

    switch(*cmd)
    {
        case CMD_ERASE_FLASH:
            err = eraseFlash(); // get rid of log files
            if(err)
            {
                return err;
            }
            break;

        case CMD_LOG_STATUS:
            logInfo("Log entry created via terminal command");
            break;

        case CMD_REBOOT:
            k_sleep(PRE_REBOOT_DELAY);
            modemShutdown();
            sys_reboot(SYS_REBOOT_COLD);
            break;

        default:
            return -ENOTSUP;
    }

    return 0;
}
```
