## CMakeLists.txt
```
# 
#  Copyright 2026 Latvijas Mobilais Telefons
# 
#  Licensed under the Apache License, Version 2.0 (the "License");
#  you may not use this file except in compliance with the License.
#  You may obtain a copy of the License at
# 
#      http://www.apache.org/licenses/LICENSE-2.0
# 
#  Unless required by applicable law or agreed to in writing, software
#  distributed under the License is distributed on an "AS IS" BASIS,
#  WITHOUT WARRANTIES OR CONDITIONS OF ANY KIND, either express or implied.
#  See the License for the specific language governing permissions and
#  limitations under the License.
# 

cmake_minimum_required(VERSION 3.20.0)

# Include lmtSDK
set(EXTRA_ZEPHYR_MODULES "${CMAKE_CURRENT_SOURCE_DIR}/../..")

find_package(Zephyr REQUIRED HINTS $ENV{ZEPHYR_BASE})

project(gnss_demo)

FILE(GLOB app_sources src/*.c)
target_sources(app PRIVATE ${app_sources})

target_include_directories(app PRIVATE ${CMAKE_CURRENT_SOURCE_DIR}/inc)
```

## prj.conf
```kconfig
#
# Project configuration for Zephyr RTOS firmware
#
# This file lists all the features and settings enabled in the firmware.
# Each CONFIG_ option turns on or customizes a specific feature (such as sensors, power management, or communication).
# Lines starting with # are comments and are ignored by the build system.
#
# For example:
#   CONFIG_ADC=y      # Enable analog-to-digital converter (for reading analog sensors)
#   CONFIG_PWM=y      # Enable pulse-width modulation (for controlling outputs like LEDs)
#
# You can change these options to enable or disable features as needed.
#

# Enable SDK
CONFIG_LMTSDK=y
```

## src/main.c
```c
/**
 * @file main.c
 * @brief Main application file for LMT SDK sample
 *
 * This file contains a sample for setting up, starting and handling the GNSS module using
 * the IoT Shortcut SDK.
 *
 */

#include "lmt_sdk_app.h"


/**
 * @brief GNSS fix handler.
 *
 * Is called when a GNSS fix is acquired. Data from the fix is printed to the log.
 * 
 * @param[out] gnssOutput struct containing acquired GNSS fix data.
 */
void handleGnssFix(GnssFix *gnssOutput)
{
    logInfoFormatted("%02u:%02u:%02u,%.06f,%.06f,%.06f", gnssOutput->datetime.hour,
                     gnssOutput->datetime.minute, gnssOutput->datetime.seconds,
gnssOutput->latitude, gnssOutput->longitude, gnssOutput->accuracy
                    );

}

/**
 * @brief Application setup/init code
 *
 * This function sets up the system, defines the GNSS settings and starts GNSS acquisition.
 */
void appInit(void)
{
    enableSerialLog();


    GnssSettings gnss_settings = {
        .fix_interval       = 120,
        .fix_retry          = 60,
        .dynamics_mode      = STATIONARY,
        .callback = handleGnssFix,
    };
    startGnss(&gnss_settings);
}

/**
 * @brief Event callback functions
 *
 * The SDK uses an event-driven architecture where each SOM event has a corresponding callback
 * function. Users implement only the callbacks they need to handle specific events.
 *
 * Event naming pattern: EVENT_DEVICE_INIT_OK -> onDeviceInitOk (remove "EVENT_" prefix, camelCase)
 * Full list of available events is in `lmt_som_event_emitter.h`.
 *
 * To handle an event, simply implement its callback function with the signature:
 *   void onEventName(void *p_data, int i_data)
 *
 * Unimplemented callbacks are ignored by the SDK.
 */
void onDeviceInitOk(void *p_data, int i_data)
{
    logInfo("All system parts initialized successfully");
}


void onTerminalCmd(void *p_data, int i_data)
{
    // Perform the requested command and send the result
    sendEventCmdRes(runTerminalCmd(p_data, i_data));
}

/**
 * @brief Main application entry point
 *
 * This is where the program starts running. It initializes the SDK and user application,
 * then enters a loop.
 *
 * @return Returns error code (should never return in normal operation)
 */
int main(void)
{
    // Set uplink period in minutes(how often data is sent to server)
    setUplinkTimeout(5);
    // Initialize the LMT SDK (sets up core system functions)
    lmtInit();
    // Initialize the user application.
    appInit();

    while(1)
    {
        k_sleep(K_FOREVER);
    }

    return 0;
}
```

## inc/lmt_sdk_app.h
```c
/**
 * @file lmt_sdk_app.h
 * @brief Main application header. Includes core API and terminal command handler interfaces.
 *
 * This header aggregates the main SDK API and terminal command handler for use in the application.
 */

#ifndef LMT_SDK_APP_H
#define LMT_SDK_APP_H

#include "lmt_sdk_api.h"

#include "terminal_cmd_handler.h"

#endif // LMT_SDK_APP_H
```

## inc/terminal_cmd_handler.h
```c
/**
 * @file terminal_cmd_handler.h
 * @brief Interface for running terminal commands from code
 *
 * This header provides a function to run a command received as a sequence of bytes (received from
 * server).
 */

#ifndef TERMINAL_CMD_HANDLER_H
#define TERMINAL_CMD_HANDLER_H

#include <stdint.h>

/**
 * @brief Run a command received as a sequence of bytes.
 *
 * This function takes a command (as an array of bytes) and its length, and executes it.
 *
 * @param cmd Pointer to the command data (array of bytes)
 * @param cmd_len Number of bytes in the command
 * @return 0 on success, negative error code on failure
 */
int runTerminalCmd(uint8_t *cmd, uint8_t cmd_len);

#endif // TERMINAL_CMD_HANDLER_H
```

## src/terminal_cmd_handler.c
```c
/**
 * @file terminal_cmd_handler.c
 *
 * @brief This file implements a simple command handler for terminal/serial commands.
 *
 * Currently, the handler is designed to process single-character commands (e.g., 'E' for erase, 'R'
 * for reboot). The implementation can be easily extended to support multi-character or more complex
 * commands in the future.
 */

#include "terminal_cmd_handler.h"
#include "lmt_coap_manager.h"
#include "lmt_storage_manager.h"
#include <errno.h>
#include <string.h>
#include <zephyr/sys/reboot.h>

// List of supported commands
#define CMD_ERASE_FLASH 'E'
#define CMD_REBOOT      'R'

#define PRE_REBOOT_DELAY K_SECONDS(2)

/**
 * @brief Handle a terminal/serial command.
 *
 * This function processes a command received as a byte array. Currently, only the first character
 * is used. Supported commands:
 *   - 'E': Erase flash (delete log files)
 *   - 'R': Reboot the system
 *
 * The handler can be easily extended to support more or multi-character commands in the future.
 *
 * @param cmd Pointer to the command data (array of bytes)
 * @param cmd_len Number of bytes in the command
 * @return 0 on success, negative error code on failure or unsupported command
 */
int runTerminalCmd(uint8_t *cmd, uint8_t cmd_len)
{
    int error = 0;

    // Check for valid input
    if(cmd == NULL || cmd_len == 0)
    {
        return -EINVAL; // Invalid argument
    }

    // Only the first character of the command is used
    switch(*cmd)
    {
        case CMD_ERASE_FLASH:
            // Erase flash memory (e.g., delete log files)
            error = eraseFlash();
            if(error)
            {
                return error; // Return error code if erase fails
            }
            break;

        case CMD_REBOOT:
            // Shut down modem, log a warning, wait, then reboot the system
            modemShutdown();
            logWarning("Rebooting system...");
            k_sleep(PRE_REBOOT_DELAY);   // Wait before rebooting
            sys_reboot(SYS_REBOOT_COLD); // Perform a cold reboot
            break;

        default:
            // Command not supported
            return -ENOTSUP;
    }

    // Command handled successfully
    return 0;
}
```
