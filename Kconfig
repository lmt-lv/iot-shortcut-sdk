## Kconfig
```kconfig
# Copyright 2025 Latvijas Mobilais Telefons
#
# Licensed under the Apache License, Version 2.0 (the "License");
# you may not use this file except in compliance with the License.
# You may obtain a copy of the License at
#
#     http://www.apache.org/licenses/LICENSE-2.0
#
# Unless required by applicable law or agreed to in writing, software
# distributed under the License is distributed on an "AS IS" BASIS,
# WITHOUT WARRANTIES OR CONDITIONS OF ANY KIND, either express or implied.
# See the License for the specific language governing permissions and
# limitations under the License.


config LMTSDK
    bool "Enable lmtSDK module"
    default y
    select LOG
    select SERIAL
    select NETWORKING
    select NET_SOCKETS
    select NET_SOCKETS_OFFLOAD
    select NET_SOCKETS_POSIX_NAMES
    select LTE_LINK_CONTROL
    select LTE_LC_RAI_MODULE
    select LTE_LC_CONN_EVAL_MODULE
    select LTE_LC_PSM_MODULE
    select LTE_LC_EDRX_MODULE
    select POSIX_API
    select NRF_MODEM_LIB
    select MODEM_KEY_MGMT
    select MODEM_INFO
    select LTE_RAI_REQ
    select COAP
    select COAP_EXTENDED_OPTIONS_LEN
    select DATE_TIME
    select DATE_TIME_AUTO_UPDATE
    select CJSON_LIB
    select NANOPB
    select FILE_SYSTEM
    select FILE_SYSTEM_LITTLEFS
    select FILE_SYSTEM_MKFS
    select FLASH
    select FLASH_MAP
    select FLASH_PAGE_LAYOUT
    select SPI_NOR_IDLE_IN_DPD
    select NVS
    select SPI
    select SPI_NOR
    select FLASH_JESD216_API
    select PM_PARTITION_REGION_LITTLEFS_EXTERNAL
    select PM_OVERRIDE_EXTERNAL_DRIVER_CHECK
    select STREAM_FLASH
    select IMG_MANAGER
    select ASSERT
    select POWEROFF
    select PM_DEVICE
    select FPU
    select REBOOT

if LMTSDK

config NET_NATIVE
    bool
    default n

# CONFIG_LTE_PSM_REQ_RPTAU for more information
config LTE_PSM_RPTAU
    string
    default "00111000"

config COAP_EXTENDED_OPTIONS_LEN_VALUE
    int
    default 40

config SPI_NOR_FLASH_LAYOUT_PAGE_SIZE
    int
    default 4096

config PM_PARTITION_SIZE_LITTLEFS
    hex
    default 0x400000

config IMG_BLOCK_BUF_SIZE
    int
    default 1024

config PM_EXTERNAL_FLASH_MCUBOOT_SECONDARY
    bool
    default n

choice FS_LOG_LEVEL_CHOICE
    prompt "Date Time Log Level"
    default FS_LOG_LEVEL_OFF
endchoice

choice SPI_NOR_SFDP
    prompt "SPI NOR SFDP support"
    default SPI_NOR_SFDP_RUNTIME
endchoice

config COAP_QUEUE_SIZE
    int "CoAP queue size"
    default 96
    help
      Number of CoAP messages that can be queued.

endif # LMTSDK
```

## boards/arm/lmt_som_nrf9151/Kconfig.board
```kconfig
# Copyright (c) 2025 Latvijas Mobilais Telefons
# SPDX-License-Identifier: Apache-2.0

# LMT nRF9151 SoM configuration

if SOC_NRF9151_LACA

config BOARD_LMT_SOM_NRF9151
	bool "LMT nRF9151 SoM"

config BOARD_LMT_SOM_NRF9151_NS
	bool "LMT nRF9151 SoM non-secure"

endif # SOC_NRF9151_LACA
```

## boards/arm/lmt_som_nrf9151/lmt_som_nrf9151_defconfig
```kconfig
# SPDX-License-Identifier: Apache-2.0

CONFIG_SOC_SERIES_NRF91X=y
CONFIG_SOC_NRF9151_LACA=y
CONFIG_BOARD_LMT_SOM_NRF9151=y

# Enable MPU
CONFIG_ARM_MPU=y

# Enable TrustZone-M
CONFIG_ARM_TRUSTZONE_M=y

# Hardware stack protection
CONFIG_HW_STACK_PROTECTION=y

# enable GPIO
CONFIG_GPIO=y

# Enable uart driver
CONFIG_SERIAL=y

# enable console
CONFIG_CONSOLE=y
CONFIG_UART_CONSOLE=y
```

## boards/arm/lmt_som_nrf9151/lmt_som_nrf9151_ns_defconfig
```kconfig
# SPDX-License-Identifier: Apache-2.0

CONFIG_SOC_SERIES_NRF91X=y
CONFIG_SOC_NRF9151_LACA=y
CONFIG_BOARD_LMT_SOM_NRF9151_NS=y

# Enable MPU
CONFIG_ARM_MPU=y

# Enable TrustZone-M
CONFIG_ARM_TRUSTZONE_M=y

# This Board implies building Non-Secure firmware
CONFIG_TRUSTED_EXECUTION_NONSECURE=y

# Hardware stack protection
CONFIG_HW_STACK_PROTECTION=y

# enable GPIO
CONFIG_GPIO=y

# enable console
CONFIG_CONSOLE=y
CONFIG_UART_CONSOLE=y

# Enable RTT debug console
CONFIG_RTT_CONSOLE=y
CONFIG_USE_SEGGER_RTT=y
CONFIG_LOG_BACKEND_RTT=y

# LMT SoM specific configurations
CONFIG_PM_PARTITION_SIZE_LITTLEFS=0x400000
CONFIG_PM_EXTERNAL_FLASH_MCUBOOT_SECONDARY=n
```

## boards/arm/lmt_som_nrf9160/Kconfig.board
```kconfig
# Copyright (c) 2025 Latvijas Mobilais Telefons
# SPDX-License-Identifier: Apache-2.0

# LMT nRF9160 SoM configuration

if SOC_NRF9160_SICA

config BOARD_LMT_SOM_NRF9160
	bool "LMT nRF9160 SoM"

config BOARD_LMT_SOM_NRF9160_NS
	bool "LMT nRF9160 SoM non-secure"

endif # SOC_NRF9160_SICA
```

## boards/arm/lmt_som_nrf9160/lmt_som_nrf9160_defconfig
```kconfig
# Copyright (c) 2025 Latvijas Mobilais Telefons
# SPDX-License-Identifier: Apache-2.0

CONFIG_SOC_SERIES_NRF91X=y
CONFIG_SOC_NRF9160_SICA=y
CONFIG_BOARD_LMT_SOM_NRF9160=y

# Enable MPU
CONFIG_ARM_MPU=y

# Enable TrustZone-M
CONFIG_ARM_TRUSTZONE_M=y

# Hardware stack protection
CONFIG_HW_STACK_PROTECTION=y

# enable GPIO
CONFIG_GPIO=y

# Enable RTT debug console
CONFIG_RTT_CONSOLE=y
CONFIG_USE_SEGGER_RTT=y
CONFIG_LOG_BACKEND_RTT=y

# enable console
CONFIG_CONSOLE=y
CONFIG_UART_CONSOLE=y
```

## boards/lmt/lmt9151som/Kconfig.lmt9151som
```kconfig
# IoT Shortcut SoM NRF9151 board configuration

# Copyright (c) 2025 Latvijas Mobilais Telefons
# SPDX-License-Identifier: Apache-2.0

config BOARD_LMT9151SOM
	select SOC_NRF9151_LACA
```

## boards/lmt/lmt9151som/board.yml
```yaml
board:
  name: lmt9151som
  vendor: lmt iot
  socs:
  - name: nrf9151
    variants:
    - name: 'ns'
```
